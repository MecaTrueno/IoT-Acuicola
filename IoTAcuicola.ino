#include <OneWire.h>
#include <DallasTemperature.h>
#include <SoftwareSerial.h>                            
#include <PID_v1.h>
#include <ArduinoJson.h>
#define ONE_WIRE_BUS 9
#define rx 12                                          
#define tx 13                                          
OneWire oneWire(ONE_WIRE_BUS);
DallasTemperature sensors(&oneWire);
SoftwareSerial myserial(rx, tx);                      
/////////////////////////////////////////////////////////////////////////////////////////////////////////////////////////////////////////////////////////////////////////////////////////////////////////////////////////////////////
String inputstring = "";                              
String sensorstring = "";                             
boolean input_string_complete = false;               
boolean sensor_string_complete = false;                
boolean ODI = true;                                       
float celsius = 25, temp;
float oxigenoDisuelto = 6;
int mode = 0;
int res= 0;
double Setpoint, Input, Output;
double Setpoint2, Input2, Output2;
double Kp=2, Ki=5, Kd=1;
double Kp2=2, Ki2=5, Kd2=1;
/////////////////////////////////////////////////////////////////////////////////////////////////////////////////////////////////////////////////////////////////////////////////////////////////////////////////////////////////////
PID pidTemp(&Input, &Output, &Setpoint, Kp, Ki, Kd, DIRECT);
PID pidOxi(&Input2, &Output2, &Setpoint2, Kp2, Ki2, Kd2, DIRECT);
/////////////////////////////////////////////////////////////////////////////////////////////////////////////////////////////////////////////////////////////////////////////////////////////////////////////////////////////////////
void setup() {
  Serial.begin(9600);                                
  myserial.begin(9600);                              
  inputstring.reserve(10);                           
  sensorstring.reserve(30);                          
  Setpoint = 33;
  Setpoint2 = 9;
  pidTemp.SetMode(AUTOMATIC);
  pidOxi.SetMode(AUTOMATIC);
  pinMode(3,OUTPUT);
  pinMode(5,OUTPUT);
  myserial.print("Cal");
  myserial.print('\r');
  myserial.print("s,0");
  myserial.print('\r');
  delay(10000);
}
/////////////////////////////////////////////////////////////////////////////////////////////////////////////////////////////////////////////////////////////////////////////////////////////////////////////////////////////////////
void serialEvent() {                                 
  inputstring = Serial.readStringUntil(13);          
  input_string_complete = true;                      
}
/////////////////////////////////////////////////////////////////////////////////////////////////////////////////////////////////////////////////////////////////////////////////////////////////////////////////////////////////////
void loop() {
    automatico();  
}
/////////////////////////////////////////////////////////////////////////////////////////////////////////////////////////////////////////////////////////////////////////////////////////////////////////////////////////////////////
void Json(){
  StaticJsonDocument<64> doc;
  float C = ((int) (celsius*10))/10.0;
  float DO = ((int) (oxigenoDisuelto*10))/10.0;
  if(DO>1 && DO<16){
    doc["T"] = C;
    doc["O"] = DO;
    String salida;
    serializeJson(doc, salida);
    Serial.println(salida);
  } 
}
/////////////////////////////////////////////////////////////////////////////////////////////////////////////////////////////////////////////////////////////////////////////////////////////////////////////////////////////////////
void temperatura(){
  sensors.requestTemperatures();
  temp = sensors.getTempCByIndex(0);
  if(temp> -127){
    celsius= temp;
    String t="t,"+ String(celsius);
    res++;
    if(res>=10){
      myserial.print(t);
      myserial.print('\r');
      res=0;
    }
  }
}
/////////////////////////////////////////////////////////////////////////////////////////////////////////////////////////////////////////////////////////////////////////////////////////////////////////////////////////////////////
void oxygenoD(){

  
  if (input_string_complete == true) {                
    myserial.print(inputstring);                      
    myserial.print('\r');                            
    inputstring = "";                                
    input_string_complete = false;                   
  }

  if (myserial.available() > 0) {                   
    char inchar = (char)myserial.read();              
    sensorstring += inchar;                           
    if (inchar == '\r') {                             
      sensor_string_complete = true;                  
    }
  }
  
  if (sensor_string_complete == true) {              
    oxigenoDisuelto = sensorstring.toFloat();
    ODI =false;
    sensorstring = "";                               
    sensor_string_complete = false;                 
  }
  
}
/////////////////////////////////////////////////////////////////////////////////////////////////////////////////////////////////////////////////////////////////////////////////////////////////////////////////////////////////////
void pidTemperatura(){
  Input = celsius;
  pidTemp.Compute();
  analogWrite(3, Output);
}
/////////////////////////////////////////////////////////////////////////////////////////////////////////////////////////////////////////////////////////////////////////////////////////////////////////////////////////////////////
void pidOxigeno(){
  Input2 = oxigenoDisuelto;
  pidOxi.Compute();
  analogWrite(5, Output2);
}
/////////////////////////////////////////////////////////////////////////////////////////////////////////////////////////////////////////////////////////////////////////////////////////////////////////////////////////////////////
void automatico(){
  lecturaSensores();
  Json();
  delay(1000);
}
/////////////////////////////////////////////////////////////////////////////////////////////////////////////////////////////////////////////////////////////////////////////////////////////////////////////////////////////////////
void onlySensors(){
  analogWrite(3, 0);
  analogWrite(5, 0);
  lecturaSensores();
}
/////////////////////////////////////////////////////////////////////////////////////////////////////////////////////////////////////////////////////////////////////////////////////////////////////////////////////////////////////
void lecturaSensores(){
  temperatura();
  while(ODI){
    oxygenoD();
  }
  ODI=true;
}
/////////////////////////////////////////////////////////////////////////////////////////////////////////////////////////////////////////////////////////////////////////////////////////////////////////////////////////////////////
void controlPID(){
  pidTemperatura();
  pidOxigeno();
}
